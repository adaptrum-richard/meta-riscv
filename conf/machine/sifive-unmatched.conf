## conf/machine/sifive-unmatched.conf
```bitbake
#@TYPE: Machine
#@NAME: SiFive unmatched
#@SOC: SiFive fu740
#@DESCRIPTION: Machine configuration for the HiFive unmatched development board

DEFAULTTUNE ?= "riscv64"
require conf/machine/include/riscv/tune-riscv.inc

MACHINE_FEATURES = "screen keyboard ext2 ext3 serial alsa pci usbhost vfat"

KERNEL_IMAGETYPE = "Image.gz"

PREFERRED_PROVIDER_virtual/kernel ?= "linux-sifive-unmatched-dev"
PREFERRED_PROVIDER_virtual/bootloader ?= "u-boot-sifive-unmatched"

EXTRA_IMAGEDEPENDS += "opensbi"
RISCV_SBI_PLAT = "generic"

SERIAL_CONSOLES = "115200;ttySIF0"

MACHINE_EXTRA_RRECOMMENDS += " kernel-modules"

IMAGE_FSTYPES ?= "ext4.xz tar.xz wic.bmap wic.xz squashfs"
KERNEL_DEVICETREE ?= "sifive/hifive-unmatched-a00.dtb"

## Do not update fstab file when using wic images
# WIC_CREATE_EXTRA_ARGS ?= "--no-fstab-update"
# U-Boot SPL
SPL_BINARY ?= "spl/u-boot-spl.bin"

# U-Boot ITB (FIT image with U-Boot S-mode, OpenSBI FW_DYNAMIC, DTB [from
# U-Boot source code tree])
UBOOT_SUFFIX ?= "itb"

EXTRA_IMAGEDEPENDS += "u-boot-sifive-unmatched"
UBOOT_MACHINE = "sifive_unmatched_defconfig"

#UBOOT_ENTRYPOINT = "0x80200000"
#UBOOT_DTB_LOADADDRESS = "0x82200000"
#UBOOT_DTB = "1"
#UBOOT_DTB_BINARY ?= "hifive-unmatched-a00.dtb"


## wic default support
WKS_FILE_DEPENDS ?= " \
    opensbi \
    squashfs-tools-native \
    e2fsprogs-native \
    bmap-tools-native \
"

IMAGE_BOOT_FILES ?= " \
    hifive-unmatched-a00.dtb \
    Image.gz-sifive-unmatched.bin \
"
WKS_FILE ?= "sifive-unmatched.wks"
```
